## config/boards/shields/companion-totem/Kconfig.defconfig
```kconfig
# Copyright (c) 2022 The ZMK Contributors
# SPDX-License-Identifier: MIT

if SHIELD_COMPANION-TOTEM_LEFT

config ZMK_KEYBOARD_NAME
    default "COMPANION-TOTEM"
    
config ZMK_SPLIT_ROLE_CENTRAL
    default y

endif

if SHIELD_COMPANION-TOTEM_LEFT || SHIELD_COMPANION-TOTEM_RIGHT

config ZMK_SPLIT
    default y

endif
```

## config/boards/shields/companion-totem/Kconfig.shield
```kconfig
# Copyright (c) 2022 The ZMK Contributors
# SPDX-License-Identifier: MIT

config SHIELD_COMPANION-TOTEM_LEFT
    def_bool $(shields_list_contains,companion-totem_left)

config SHIELD_COMPANION-TOTEM_RIGHT
    def_bool $(shields_list_contains,companion-totem_right)
```

## config/boards/shields/companion_totem_tp/Kconfig.defconfig
```kconfig
# Copyright (c) 2022 The ZMK Contributors
# SPDX-License-Identifier: MIT

if SHIELD_COMPANION_TOTEM_TP_RIGHT

config ZMK_KEYBOARD_NAME
    default "COMPANION_TP"
    
config ZMK_SPLIT_ROLE_CENTRAL
    default y

endif

if SHIELD_COMPANION_TOTEM_TP_LEFT || SHIELD_COMPANION_TOTEM_TP_RIGHT

config ZMK_SPLIT
    default y

endif
```

## config/boards/shields/companion_totem_tp/Kconfig.shield
```kconfig
# Copyright (c) 2022 The ZMK Contributors
# SPDX-License-Identifier: MIT

config SHIELD_COMPANION_TOTEM_TP_LEFT
    def_bool $(shields_list_contains,companion_totem_tp_left)

config SHIELD_COMPANION_TOTEM_TP_RIGHT
    def_bool $(shields_list_contains,companion_totem_tp_right)
```

## config/west.yml
```yaml
manifest:
  remotes:
    - name: zmkfirmware
      url-base: https://github.com/zmkfirmware
    # - name: kyleswson
    #   url-base: https://github.com/kyleswson
    - name: infused-kim
      url-base: https://github.com/infused-kim
    - name: badjeff
      url-base: https://github.com/badjeff
    - name: urob
      url-base: https://github.com/urob
    - name: dhruvinsh
      url-base: https://github.com/dhruvinsh
  projects:
    #
    # zmk fork
    # Uncomment only one of these...
    #

    # Standard, stable zmk repo without mouse PR.
    # Not compatible with the PS/2 mouse & TP driver module.
    - name: zmk
      remote: zmkfirmware
      revision: main
      import: app/west.yml

    # infused-kim's zmk fork with mouse PR, which might be a bit outdated, but
    # is known to be compatible with the PS/2 mouse & TP driver module.
    # - name: zmk
    #  remote: infused-kim
    #  revision: pr-testing/mouse_ps2_module_base
    #  import: app/west.yml

    # pete's zmk fork with the most up to date mouse PR, which is more
    # up-to-date, but may contain incompatibilities with the PS/2 mouse & TP
    # driver module.
    # - name: zmk
    #   remote: petejohanson
    #   revision: feat/pointers-move-scroll
    #   import: app/west.yml

    # urob's zmk fork with mouse PR & many extra features, but may be
    # incompatible with the PS/2 mouse & TP driver module.
    # - name: zmk
    #  remote: urob
    #  revision: v0.3.0
    #  import: app/west.yml

    # infused-kim's zmk fork with mouse PR AND urob's improvements, which
    # might be out-dated, but is known to be compatible with PS/2 mouse & TP
    # driver module.
    # - name: zmk
    #   remote: infused-kim
    #   revision: pr-testing/mouse_ps2_module_base_urob
    #   import: app/west.yml
   # zmk module for PS/2 mouse / TP driver
    - name: kb_zmk_ps2_mouse_trackpoint_driver
      remote: badjeff
      revision: main
    - name: zmk-tri-state
      remote: dhruvinsh
      revision: main
  self:
    path: config
```
